#define OUT 2
#define IN 3
#define LED 4
int HI = 0;
long duration, distance;

int port[] = {36,37,38,39,40,41,42,43,44,45,46,47,48,49,51,53};
           //{1 ,0 ,0 ,1 ,0 ,0 ,1 ,0 ,0 ,0 ,1 ,0 ,1 ,1 ,0 ,1 }
int num[32][16] = {
  {1 ,0 ,1 ,1 ,1 ,0 ,1 ,1 ,1 ,1 ,0 ,0 ,1 ,1 ,1 ,1 },  //0
  {1 ,0 ,0 ,1 ,0 ,0 ,1 ,0 ,1 ,0 ,0 ,0 ,1 ,1 ,1 ,1 },  //1
  {1 ,0 ,1 ,0 ,0 ,1 ,1 ,1 ,1 ,1 ,0 ,0 ,1 ,1 ,1 ,1 },  //2
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  {1 ,0 ,0 ,1 ,0 ,0 ,1 ,0 ,0 ,0 ,1 ,0 ,1 ,1 ,0 ,1 }   //HI
  
};


void setup() {
  pinMode(OUT, OUTPUT);
  pinMode(IN, INPUT);
  pinMode(LED, OUTPUT);
  for(int i = 0 ; i < 16 ; i++ )
    pinMode(port[i], OUTPUT);
}

void loop() {

  
    digitalWrite(OUT, LOW);
    delayMicroseconds(2);
    digitalWrite(OUT, HIGH);
    delayMicroseconds(10);
    digitalWrite(OUT, LOW);

    duration = pulseIn(IN, HIGH);

    distance = duration*17/1000;

    int flk = distance*10;

    if(distance <= 30){
      flicker(flk);
    }
  
    if(distance > 30){
      HI = 31;
    }else if(distance <= 30){
      HI = distance;
    }
    segment(HI);
}

int flicker(int t){
  digitalWrite(LED, HIGH);
  delay(t);
  digitalWrite(LED, LOW);
  delay(t);
}

int segment(int X){
    for(int a = 0 ; a < 16 ; a++){
      digitalWrite(port[a], num[X][a]);
    }
}